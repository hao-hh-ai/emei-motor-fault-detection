## main/Kconfig.projbuild
```kconfig
menu "峨眉派 电机故障检测"

    config MQTT_BROKER_URI
        string "MQTT Broker URI"
        default "mqtt://192.168.1.1:1883"
        help
            MQTT Broker 地址，格式: mqtt://host:port

endmenu
```

## sdkconfig.defaults
```kconfig
CONFIG_ESP_WIFI_ENABLED=y
CONFIG_WIFI_SSID="ci"
CONFIG_WIFI_PASSWORD="ci"
CONFIG_MQTT_BROKER_URI="mqtt://localhost:1883"
```
